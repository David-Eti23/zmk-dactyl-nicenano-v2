// dactyl_cc_right.overlay

#include "dactyl_cc.dtsi"

&default_transform { // The matrix transform for this board is 6 columns over because the left half is 6 columns wide according to the matrix.
    col-offset = <6>;
};

&kscan0 {
    col-gpios
        = <&gpio0 31 GPIO_ACTIVE_HIGH> // col5 in the schematic
        , <&gpio0 29 GPIO_ACTIVE_HIGH> // col4 in the schematic
        , <&gpio0  2 GPIO_ACTIVE_HIGH> // col3 in the schematic
        , <&gpio1 15 GPIO_ACTIVE_HIGH> // col2 in the schematic
        , <&gpio1 13 GPIO_ACTIVE_HIGH> // col1 in the schematic
        , <&gpio1 11 GPIO_ACTIVE_HIGH> // col0 in the schematic
        ;
};
